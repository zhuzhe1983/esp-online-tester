## docs/fixtures/classic-psram-idf/sdkconfig.defaults
```kconfig
CONFIG_IDF_TARGET="esp32"
CONFIG_APP_COMPILE_TIME_DATE=n
CONFIG_FREERTOS_UNICORE=y
CONFIG_SPIRAM_SUPPORT=y
CONFIG_SPIRAM=y
CONFIG_SPIRAM_BOOT_INIT=y
CONFIG_SPIRAM_MEMTEST=y
CONFIG_SPIRAM_USE_CAPS_ALLOC=y
CONFIG_SPIRAM_SPEED_80M=y
CONFIG_SPIRAM_TYPE_ESPPSRAM32=y
CONFIG_SPIRAM_BANKSWITCH_ENABLE=n
CONFIG_ESPTOOLPY_FLASHFREQ_80M=y
CONFIG_ESPTOOLPY_FLASHSIZE_4MB=y
CONFIG_ESP_CONSOLE_UART_BAUDRATE=115200
CONFIG_LOG_DEFAULT_LEVEL_INFO=y
CONFIG_COMPILER_OPTIMIZATION_PERF=y
```

## examples/esp-hosted-p4/station/sdkconfig.defaults.rev3
```kconfig
CONFIG_ESP_WIFI_SOFTAP_SUPPORT=n

CONFIG_IDF_TARGET="esp32p4"
CONFIG_ESP_WIFI_SSID="esp32sim"
CONFIG_ESP_WIFI_PASSWORD="esp32sim-pass"
```

## tools/fixtures/atom-matrix-firmware/sdkconfig.defaults
```kconfig
CONFIG_IDF_TARGET="esp32"
CONFIG_ESPTOOLPY_FLASHSIZE_4MB=y
CONFIG_ESPTOOLPY_FLASHMODE_DIO=y
CONFIG_FREERTOS_UNICORE=y
CONFIG_ESP_CONSOLE_UART_DEFAULT=y
CONFIG_ESP_TASK_WDT_EN=n
CONFIG_COMPILER_OPTIMIZATION_SIZE=y
CONFIG_APP_REPRODUCIBLE_BUILD=y
CONFIG_ESP_DEFAULT_CPU_FREQ_MHZ_240=y
```

## tools/fixtures/atoms3r-firmware/sdkconfig.defaults
```kconfig
CONFIG_IDF_TARGET="esp32s3"
CONFIG_ESPTOOLPY_FLASHSIZE_8MB=y
CONFIG_ESPTOOLPY_FLASHMODE_DIO=y
CONFIG_FREERTOS_UNICORE=y
CONFIG_ESP_CONSOLE_UART_DEFAULT=y
CONFIG_ESP_TASK_WDT_EN=n
CONFIG_COMPILER_OPTIMIZATION_SIZE=y
CONFIG_APP_REPRODUCIBLE_BUILD=y
CONFIG_SPIRAM=y
CONFIG_SPIRAM_MODE_OCT=y
CONFIG_SPIRAM_SPEED_40M=y
CONFIG_SPIRAM_USE_MALLOC=y
CONFIG_SPIRAM_MEMTEST=y
```

## tools/fixtures/device-storage-firmware/sdkconfig.defaults
```kconfig
CONFIG_IDF_TARGET="esp32s3"
CONFIG_ESPTOOLPY_FLASHSIZE_8MB=y
CONFIG_ESPTOOLPY_FLASHMODE_DIO=y
CONFIG_FREERTOS_UNICORE=y
CONFIG_ESP_CONSOLE_UART_DEFAULT=y
CONFIG_ESP_TASK_WDT_EN=n
CONFIG_COMPILER_OPTIMIZATION_SIZE=y
CONFIG_APP_REPRODUCIBLE_BUILD=y
CONFIG_PARTITION_TABLE_CUSTOM=y
CONFIG_PARTITION_TABLE_CUSTOM_FILENAME="partitions.csv"
```

## tools/fixtures/stamp-c6lora-firmware/sdkconfig.defaults
```kconfig
CONFIG_IDF_TARGET="esp32c6"
CONFIG_ESPTOOLPY_FLASHSIZE_16MB=y
CONFIG_ESPTOOLPY_FLASHMODE_DIO=y
CONFIG_ESP_CONSOLE_UART_DEFAULT=y
CONFIG_ESP_TASK_WDT_EN=n
CONFIG_COMPILER_OPTIMIZATION_SIZE=y
CONFIG_APP_REPRODUCIBLE_BUILD=y
CONFIG_ESP_DEFAULT_CPU_FREQ_MHZ_160=y
```

## tools/fixtures/stamp-p4-firmware/sdkconfig.defaults
```kconfig
CONFIG_IDF_TARGET="esp32p4"
CONFIG_ESP32P4_SELECTS_REV_LESS_V3=y
CONFIG_ESP32P4_REV_MIN_100=y
CONFIG_ESPTOOLPY_FLASHSIZE_16MB=y
CONFIG_FLASHMODE_QIO=y
CONFIG_SPIRAM=y
CONFIG_SPIRAM_SPEED_80M=y
CONFIG_SPIRAM_MEMTEST=n
CONFIG_SPIRAM_IGNORE_NOTFOUND=n
CONFIG_ESP_CONSOLE_UART_DEFAULT=y
CONFIG_ESP_TASK_WDT_EN=n
CONFIG_COMPILER_OPTIMIZATION_SIZE=y
CONFIG_APP_REPRODUCIBLE_BUILD=y
```

## tools/fixtures/stampc3-firmware/main/Kconfig.projbuild
```kconfig
config STAMP_C3U_BUTTON
    bool "Stamp-C3U G9 button instead of Stamp-C3 G3"
    default n
```

## tools/fixtures/unit-hub-firmware/sdkconfig.defaults
```kconfig
CONFIG_IDF_TARGET="esp32s3"
CONFIG_ESPTOOLPY_FLASHSIZE_16MB=y
CONFIG_ESPTOOLPY_FLASHMODE_DIO=y
CONFIG_FREERTOS_UNICORE=y
CONFIG_ESP_CONSOLE_UART_DEFAULT=y
CONFIG_ESP_TASK_WDT_EN=n
CONFIG_COMPILER_OPTIMIZATION_SIZE=y
CONFIG_APP_REPRODUCIBLE_BUILD=y
```
